// SPDX-License-Identifier: BSD-3-Clause

#include <skeleton64.dtsi>
#include <lk2nd.dtsi>

/ {
	qcom,msm-id = <QCOM_ID_MSM8974PRO_AC 118 0x10001>;
};

&lk2nd {
	model = "Nokia Lumia 930";
	compatible = "nokia,martini";
	lk2nd,match-cmdline = "*Nokia-martini*";


	gpio-keys {
		compatible = "gpio-keys";
	};
};
